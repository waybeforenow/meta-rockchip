## conf/machine/evb-rk808-rk3288.conf
```bitbake
# Copyright (C) 2017 Fuzhou Rockchip Electronics Co., Ltd
# Released under the MIT license (see COPYING.MIT for the terms)

#@TYPE: Machine
#@NAME: EVB 3288 rk808

include conf/machine/include/rk3288.inc

KERNEL_DEVICETREE = "rk3288-evb-rk808-linux.dtb"
UBOOT_MACHINE = "evb-rk3288_defconfig"
```

## conf/machine/firefly-reload-rk3288.conf
```bitbake
# Copyright (C) 2015 Romain Perier
# Released under the MIT license (see COPYING.MIT for the terms)

include conf/machine/include/rk3288.inc

KERNEL_DEVICETREE = "rk3288-firefly-reload-linux.dtb"
UBOOT_MACHINE = "firefly-rk3288_defconfig"
```

## conf/machine/include/rk3066.inc
```bitbake
# Copyright (C) 2014 NEO-Technologies
# Released under the MIT license (see COPYING.MIT for the terms)

SOC_FAMILY = "rk3066"

require conf/machine/include/tune-cortexa9.inc
require conf/machine/include/soc-family.inc

MACHINEOVERRIDES_EXTENDER  = "mali-gpu:mali-utgard"

PREFERRED_PROVIDER_virtual/kernel = "linux-rockchip"
PREFERRED_VERSION_linux-rockchip = "4.4"

SERIAL_CONSOLES = "115200;ttyS2"
KERNEL_IMAGETYPE = "zImage"
KBUILD_DEFCONFIG = "rockchip_linux_defconfig"

PREFERRED_PROVIDER_virtual/bootloader ?= ""

IMAGE_FSTYPES += "ext4 squashfs"
```

## conf/machine/rockchip-rk3328-rock64.conf
```bitbake
#@TYPE: Machine
#@NAME: RK3328 Rock64

require conf/machine/include/rk3328.inc

KERNEL_DEVICETREE = "rockchip/rk3328-rock64.dtb"

UBOOT_MACHINE = "evb-rk3328_defconfig"

RK_WIFIBT_FIRMWARES = " "
```

## conf/machine/virtual-arm9.conf
```bitbake
require conf/machine/include/tune-arm920t.inc
require conf/machine/include/soc-family.inc

PREFERRED_PROVIDER_virtual/bootloader ?= ""
PREFERRED_PROVIDER_virtual/kernel = "linux-dummy"
SERIAL_CONSOLES = "115200;ttyS1"
IMAGE_FSTYPES += "ext4 squashfs"
```
